DIAG.LOGGER /AREA /STDOUT /PRINTCMD
print "unlock flash"

PER.Set.simple ANC:0xF7FF4008 %Long 0
PER.Set.simple ANC:0xF7FF4020 %Long 0x89abcdef
PER.Set.simple ANC:0xF7FF4024 %Long 0x01234567
PER.Set.simple ANC:0xF7FF4028 %Long 0x89abcdef
PER.Set.simple ANC:0xF7FF402C %Long 0x01234567
PER.Set.simple ANC:0xF7FF4030 %Long 0x89abcdef
PER.Set.simple ANC:0xF7FF4034 %Long 0x01234567
PER.Set.simple ANC:0xF7FF4038 %Long 0x89abcdef
PER.Set.simple ANC:0xF7FF403C %Long 0x01234567
PER.Set.simple ANC:0xF7FF4100 %Long 0
PER.Set.simple ANC:0xF7FF4104 %Long 0
PER.Set.simple ANC:0xF7FF4108 %Long 0
PER.Set.simple ANC:0xF7FF410C %Long 0

PER.Set.simple ANC:0xF7FF4008 %Long 1
PER.Set.simple ANC:0xF7FF4020 %Long 0x89abcdef
PER.Set.simple ANC:0xF7FF4024 %Long 0x01234567
PER.Set.simple ANC:0xF7FF4028 %Long 0x89abcdef
PER.Set.simple ANC:0xF7FF402C %Long 0x01234567
PER.Set.simple ANC:0xF7FF4030 %Long 0x89abcdef
PER.Set.simple ANC:0xF7FF4034 %Long 0x01234567
PER.Set.simple ANC:0xF7FF4038 %Long 0x89abcdef
PER.Set.simple ANC:0xF7FF403C %Long 0x01234567
PER.Set.simple ANC:0xF7FF4110 %Long 0
PER.Set.simple ANC:0xF7FF4114 %Long 0
PER.Set.simple ANC:0xF7FF4118 %Long 0
PER.Set.simple ANC:0xF7FF411C %Long 0

PER.Set.simple ANC:0xF7FF4008 %Long 2
PER.Set.simple ANC:0xF7FF4020 %Long 0x89abcdef
PER.Set.simple ANC:0xF7FF4024 %Long 0x01234567
PER.Set.simple ANC:0xF7FF4028 %Long 0x89abcdef
PER.Set.simple ANC:0xF7FF402C %Long 0x01234567
PER.Set.simple ANC:0xF7FF4030 %Long 0x89abcdef
PER.Set.simple ANC:0xF7FF4034 %Long 0x01234567
PER.Set.simple ANC:0xF7FF4038 %Long 0x89abcdef
PER.Set.simple ANC:0xF7FF403C %Long 0x01234567
PER.Set.simple ANC:0xF7FF4120 %Long 0
PER.Set.simple ANC:0xF7FF4124 %Long 0
PER.Set.simple ANC:0xF7FF4128 %Long 0
PER.Set.simple ANC:0xF7FF412C %Long 0

PER.Set.simple ANC:0xF7FF4008 %Long 3
PER.Set.simple ANC:0xF7FF4020 %Long 0x89abcdef
PER.Set.simple ANC:0xF7FF4024 %Long 0x01234567
PER.Set.simple ANC:0xF7FF4028 %Long 0x89abcdef
PER.Set.simple ANC:0xF7FF402C %Long 0x01234567
PER.Set.simple ANC:0xF7FF4030 %Long 0x89abcdef
PER.Set.simple ANC:0xF7FF4034 %Long 0x01234567
PER.Set.simple ANC:0xF7FF4038 %Long 0x89abcdef
PER.Set.simple ANC:0xF7FF403C %Long 0x01234567
PER.Set.simple ANC:0xF7FF4130 %Long 0
PER.Set.simple ANC:0xF7FF4134 %Long 0
PER.Set.simple ANC:0xF7FF4138 %Long 0
PER.Set.simple ANC:0xF7FF413C %Long 0
