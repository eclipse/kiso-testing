; --------------------------------------------------------------------------------
; @Title: Example script for programming of SPC58EC80/SPC584C80 internal flash
; @Description:
; Configures debugger and processor to program the on-chip NOR flash
;
; @Author: rweiss
; @Chip: SPC58EC80 SPC584C80
; @Keywords: SPC58EC80 SPC584C80 CHORUS4M
; @Copyright: (C) 1989-2014 Lauterbach GmbH, licensed for use with TRACE32(R) only
; --------------------------------------------------------------------------------
; $Id: spc58ec80.cmm 3553 2015-12-22 12:36:57Z rweiss $

  ; Check if script is called with parameters
  ; Valid parameters:
  ;   PREPAREONLY     : prepare flash programming without user interaction
  ;   SKIPCONFIG      : skip configuration part to allow script external configuration
  ;LOCAL &elfFile &elfFbl &elfBM
  ;ENTRY &elfFile &elfFbl &elfBM

  ; ------------------------------------------------------------------------------
  ; CPU setup

	SYStem.RESet
	SYStem.BdmClock 4MHz
	SYStem.CPU SPC58EC80
	SYStem.Option.WATCHDOG OFF
	SYStem.CONFIG.CORE 2. 1.

	do BDUUnlock.cmm
	SYStem.Up

	; Initialize internal SRAM (only partially used)
	Data.Set EA:0x400A8000--0x400AFFFF %Quad 0

  ; ------------------------------------------------------------------------------
  ; Flash declaration

  FLASH.RESet

  ; Low address space
  FLASH.Create 1. 0x00404000--0x00407FFF NOP    Quad 0x02000000 /INFO "BAF (read only)"
  FLASH.Create 1. 0x00FC4000--0x00FC7FFF TARGET Quad 0x02000001
  FLASH.Create 1. 0x00FCC000--0x00FCFFFF TARGET Quad 0x02000002
  FLASH.Create 1. 0x00FC0000--0x00FC3FFF TARGET Quad 0x02000003
  FLASH.Create 1. 0x00FC8000--0x00FCBFFF TARGET Quad 0x02000004
  FLASH.Create 1. 0x0060C000--0x0060FFFF NOP    Quad 0x02000005 /INFO "HSM code 16K"
  FLASH.Create 1. 0x00FD0000--0x00FD7FFF TARGET Quad 0x02000006
  FLASH.Create 1. 0x00FD8000--0x00FDFFFF TARGET Quad 0x02000007
;  FLASH.Create 1. 0x00FE0000--0x00FEFFFF TARGET Quad 0x02000008
;  FLASH.Create 1. 0x00FF0000--0x00FFFFFF TARGET Quad 0x02000009
  FLASH.Create 1. 0x00610000--0x0061FFFF NOP    Quad 0x0200000a /INFO "HSM code 64K"
  FLASH.Create 1. 0x00620000--0x0062FFFF NOP    Quad 0x0200000b /INFO "HSM code 64K"
  ; Mid address space
  FLASH.Create 2. 0x00680000--0x00683FFF NOP    Quad 0x00000100 /INFO "HSM data"
  FLASH.Create 2. 0x00684000--0x00687FFF NOP    Quad 0x00000101 /INFO "HSM data"
  ; High address space
;  FLASH.Create 3. 0x00800000--0x00807FFF TARGET Quad 0x00000200 ; EEP datablocks
;  FLASH.Create 3. 0x00808000--0x0080FFFF TARGET Quad 0x00000201 ; EEP datablocks
;  FLASH.Create 3. 0x00810000--0x00817FFF TARGET Quad 0x00000202 ; EEP datablocks
;  FLASH.Create 3. 0x00818000--0x0081FFFF TARGET Quad 0x00000203 ; EEP datablocks
  ; 128k/256k address space
  ;FLASH.Create 4. 0x01000000--0x0101FFFF TARGET Quad 0x02000300
  FLASH.Create 4. 0x01020000--0x0103FFFF TARGET Quad 0x02000301
  FLASH.Create 4. 0x01040000--0x0107FFFF TARGET Quad 0x02000302
  FLASH.Create 4. 0x01080000--0x010BFFFF TARGET Quad 0x02000303
  FLASH.Create 4. 0x010C0000--0x010FFFFF TARGET Quad 0x02000304
  FLASH.Create 4. 0x01100000--0x0113FFFF TARGET Quad 0x02000305
  FLASH.Create 4. 0x01140000--0x0117FFFF TARGET Quad 0x02000306
  FLASH.Create 4. 0x01180000--0x011BFFFF TARGET Quad 0x02000307
  FLASH.Create 4. 0x011C0000--0x011FFFFF TARGET Quad 0x02000308
  FLASH.Create 4. 0x01200000--0x0123FFFF TARGET Quad 0x02000309
  FLASH.Create 4. 0x01240000--0x0127FFFF TARGET Quad 0x0200030a
  FLASH.Create 4. 0x01280000--0x012BFFFF TARGET Quad 0x0200030b
  FLASH.Create 4. 0x012C0000--0x012FFFFF TARGET Quad 0x0200030c
  FLASH.Create 4. 0x01300000--0x0133FFFF TARGET Quad 0x0200030d
  FLASH.Create 4. 0x01340000--0x0137FFFF TARGET Quad 0x0200030e
  FLASH.Create 4. 0x01380000--0x013BFFFF TARGET Quad 0x0200030f
  ; UTEST address space
  FLASH.Create 6. 0x00400000--0x00403FFF TARGET Quad 0x02000500 /OTP /INFO "UTEST"

  ; Overlay enabled mapping
  FLASH.CreateALIAS 0x08A00000--0x08FFFFFF 0x00A00000   ; Small & medium flash blocks
  FLASH.CreateALIAS 0x09000000--0x09FFFFFF 0x01000000   ; Large flash blocks

  FLASH.TARGET E:0x400A8000 E:0x400AA000 0x1000 ~~/demo/powerpc/flash/quad/c40fm58eg.bin /STACKSIZE 0x0200 /DualPort

  ; ------------------------------------------------------------------------------
  ; Flash programming

  do BDUUnlockFlash.cmm

  FLASH.ReProgram 0x01020000--0x013BFFFF /Erase
  Data.LOAD.Elf ~~~~/BDU3xxx-Sample_TAPP_Demo.elf

  ; Application presence pattern
  Data.Set 0x013BFFC0 %Long 0x736A293E ; set presence pattern
  Data.Set 0x013BFFC4 %Long 0x00000000 ; set presence pattern
  Data.Set 0x013BFFC8 %Long 0x00000000 ; set presence pattern
  Data.Set 0x013BFFCC %Long 0x00000000 ; set presence pattern
  ; Logical block presence pattern
  Data.Set 0x013BFFE0 %Long 0x736A293E ; set presence pattern
  Data.Set 0x013BFFE4 %Long 0x00000000 ; set presence pattern
  Data.Set 0x013BFFE8 %Long 0x00000000 ; set presence pattern
  Data.Set 0x013BFFEC %Long 0x00000000 ; set presence pattern

  ; Application presence pattern FBL v0.1.0.0
  ;Data.Set 0x013BFFE0 %Long 0x736A293E ; set presence pattern
  ;Data.Set 0x013BFFE4 %Long 0x00000000 ; set presence pattern
  ;Data.Set 0x013BFFE8 %Long 0x00000000 ; set presence pattern
  ;Data.Set 0x013BFFEC %Long 0x00000000 ; set presence pattern

  FLASH.ReProgram off
  print "Application loaded"

  ENDDO
