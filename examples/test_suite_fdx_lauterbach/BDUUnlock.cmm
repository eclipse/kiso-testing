DIAG.LOGGER /AREA /STDOUT /PRINTCMD
print "unlock"

SYStem.RESet
SYStem.BdmClock 4MHz
SYStem.CPU SPC58EC80
SYStem.Option.WATCHDOG OFF
SYStem.CONFIG.CORE 2. 1.

SYStem.Option.KEYCODE 0x01234567 0x89abcdef 0x01234567 0x89abcdef 0x01234567 0x89abcdef 0x01234567 0x89abcdef

SYStem.Option.ResBreak OFF
SYStem.Option.ResetDetection
SYStem.Option.WaitReset 100us
SYStem.Option.ResetMode PIN
